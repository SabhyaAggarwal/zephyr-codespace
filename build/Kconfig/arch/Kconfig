## build/Kconfig/arch/Kconfig
```kconfig
# Load Zephyr Arch Kconfig descriptions.
osource "/workspaces/zephyr-codespace/zephyr/arch/x86/Kconfig"
osource "/workspaces/zephyr-codespace/zephyr/arch/xtensa/Kconfig"
osource "/workspaces/zephyr-codespace/zephyr/arch/sparc/Kconfig"
osource "/workspaces/zephyr-codespace/zephyr/arch/riscv/Kconfig"
osource "/workspaces/zephyr-codespace/zephyr/arch/posix/Kconfig"
osource "/workspaces/zephyr-codespace/zephyr/arch/nios2/Kconfig"
osource "/workspaces/zephyr-codespace/zephyr/arch/mips/Kconfig"
osource "/workspaces/zephyr-codespace/zephyr/arch/arm64/Kconfig"
osource "/workspaces/zephyr-codespace/zephyr/arch/arm/Kconfig"
osource "/workspaces/zephyr-codespace/zephyr/arch/arc/Kconfig"
```

## build/Kconfig/boards/Kconfig
```kconfig
# Load Zephyr board Kconfig descriptions.
osource "/workspaces/zephyr-codespace/zephyr/boards/nxp/frdm_mcxn236/Kconfig"
```

## build/Kconfig/boards/Kconfig.defconfig
```kconfig
# Load Zephyr board defconfig descriptions.
osource "/workspaces/zephyr-codespace/zephyr/boards/nxp/frdm_mcxn236/Kconfig.defconfig"
```

## build/Kconfig/boards/Kconfig.frdm_mcxn236
```kconfig
# Load board Kconfig descriptions.
osource "/workspaces/zephyr-codespace/zephyr/boards/nxp/frdm_mcxn236/Kconfig.frdm_mcxn236"
```

## build/Kconfig/soc/Kconfig
```kconfig
# Load Zephyr SoC Kconfig descriptions.
osource "/workspaces/zephyr-codespace/zephyr/soc/xlnx/zynqmp/Kconfig"
osource "/workspaces/zephyr-codespace/zephyr/soc/xlnx/zynq7000/Kconfig"
osource "/workspaces/zephyr-codespace/zephyr/soc/xen/Kconfig"
osource "/workspaces/zephyr-codespace/zephyr/soc/ti/simplelink/Kconfig"
osource "/workspaces/zephyr-codespace/zephyr/soc/ti/lm3s6965/Kconfig"
osource "/workspaces/zephyr-codespace/zephyr/soc/ti/k3/Kconfig"
osource "/workspaces/zephyr-codespace/zephyr/soc/telink/tlsr/Kconfig"
osource "/workspaces/zephyr-codespace/zephyr/soc/starfive/jh71xx/Kconfig"
osource "/workspaces/zephyr-codespace/zephyr/soc/st/stm32/Kconfig"
osource "/workspaces/zephyr-codespace/zephyr/soc/snps/qemu_arc/Kconfig"
osource "/workspaces/zephyr-codespace/zephyr/soc/snps/nsim/arc_v/Kconfig"
osource "/workspaces/zephyr-codespace/zephyr/soc/snps/nsim/arc_classic/Kconfig"
osource "/workspaces/zephyr-codespace/zephyr/soc/snps/hsdk4xd/Kconfig"
osource "/workspaces/zephyr-codespace/zephyr/soc/snps/hsdk/Kconfig"
osource "/workspaces/zephyr-codespace/zephyr/soc/snps/emsk/Kconfig"
osource "/workspaces/zephyr-codespace/zephyr/soc/snps/emsdp/Kconfig"
osource "/workspaces/zephyr-codespace/zephyr/soc/snps/arc_iot/Kconfig"
osource "/workspaces/zephyr-codespace/zephyr/soc/silabs/Kconfig"
osource "/workspaces/zephyr-codespace/zephyr/soc/sifive/sifive_freedom/Kconfig"
osource "/workspaces/zephyr-codespace/zephyr/soc/sensry/Kconfig"
osource "/workspaces/zephyr-codespace/zephyr/soc/rockchip/Kconfig"
osource "/workspaces/zephyr-codespace/zephyr/soc/renode/riscv_virtual/Kconfig"
osource "/workspaces/zephyr-codespace/zephyr/soc/renode/cortex_r8_virtual/Kconfig"
osource "/workspaces/zephyr-codespace/zephyr/soc/renesas/smartbond/Kconfig"
osource "/workspaces/zephyr-codespace/zephyr/soc/renesas/rzt2m/Kconfig"
osource "/workspaces/zephyr-codespace/zephyr/soc/renesas/rcar/Kconfig"
osource "/workspaces/zephyr-codespace/zephyr/soc/renesas/ra/Kconfig"
osource "/workspaces/zephyr-codespace/zephyr/soc/raspberrypi/Kconfig"
osource "/workspaces/zephyr-codespace/zephyr/soc/quicklogic/eos_s3/Kconfig"
osource "/workspaces/zephyr-codespace/zephyr/soc/qemu/virt_riscv/Kconfig"
osource "/workspaces/zephyr-codespace/zephyr/soc/qemu/malta/Kconfig"
osource "/workspaces/zephyr-codespace/zephyr/soc/openisa/rv32m1/Kconfig"
osource "/workspaces/zephyr-codespace/zephyr/soc/nxp/s32/Kconfig"
osource "/workspaces/zephyr-codespace/zephyr/soc/nxp/rw/Kconfig"
osource "/workspaces/zephyr-codespace/zephyr/soc/nxp/mcx/Kconfig"
osource "/workspaces/zephyr-codespace/zephyr/soc/nxp/lpc/Kconfig"
osource "/workspaces/zephyr-codespace/zephyr/soc/nxp/layerscape/Kconfig"
osource "/workspaces/zephyr-codespace/zephyr/soc/nxp/kinetis/Kconfig"
osource "/workspaces/zephyr-codespace/zephyr/soc/nxp/imxrt/Kconfig"
osource "/workspaces/zephyr-codespace/zephyr/soc/nxp/imx/Kconfig"
osource "/workspaces/zephyr-codespace/zephyr/soc/nuvoton/numicro/Kconfig"
osource "/workspaces/zephyr-codespace/zephyr/soc/nuvoton/numaker/Kconfig"
osource "/workspaces/zephyr-codespace/zephyr/soc/nuvoton/npcx/Kconfig"
osource "/workspaces/zephyr-codespace/zephyr/soc/nuvoton/npcm/Kconfig"
osource "/workspaces/zephyr-codespace/zephyr/soc/nordic/Kconfig"
osource "/workspaces/zephyr-codespace/zephyr/soc/neorv32/Kconfig"
osource "/workspaces/zephyr-codespace/zephyr/soc/native/inf_clock/Kconfig"
osource "/workspaces/zephyr-codespace/zephyr/soc/microchip/miv/Kconfig"
osource "/workspaces/zephyr-codespace/zephyr/soc/microchip/mec/Kconfig"
osource "/workspaces/zephyr-codespace/zephyr/soc/mediatek/mtk_adsp/Kconfig"
osource "/workspaces/zephyr-codespace/zephyr/soc/lowrisc/opentitan/Kconfig"
osource "/workspaces/zephyr-codespace/zephyr/soc/litex/litex_vexriscv/Kconfig"
osource "/workspaces/zephyr-codespace/zephyr/soc/ite/ec/Kconfig"
osource "/workspaces/zephyr-codespace/zephyr/soc/intel/raptor_lake/Kconfig"
osource "/workspaces/zephyr-codespace/zephyr/soc/intel/lakemont/Kconfig"
osource "/workspaces/zephyr-codespace/zephyr/soc/intel/intel_socfpga_std/Kconfig"
osource "/workspaces/zephyr-codespace/zephyr/soc/intel/intel_socfpga/Kconfig"
osource "/workspaces/zephyr-codespace/zephyr/soc/intel/intel_niosv/Kconfig"
osource "/workspaces/zephyr-codespace/zephyr/soc/intel/intel_ish/Kconfig"
osource "/workspaces/zephyr-codespace/zephyr/soc/intel/intel_adsp/Kconfig"
osource "/workspaces/zephyr-codespace/zephyr/soc/intel/elkhart_lake/Kconfig"
osource "/workspaces/zephyr-codespace/zephyr/soc/intel/atom/Kconfig"
osource "/workspaces/zephyr-codespace/zephyr/soc/intel/apollo_lake/Kconfig"
osource "/workspaces/zephyr-codespace/zephyr/soc/intel/alder_lake/Kconfig"
osource "/workspaces/zephyr-codespace/zephyr/soc/infineon/cat3/Kconfig"
osource "/workspaces/zephyr-codespace/zephyr/soc/infineon/cat1b/Kconfig"
osource "/workspaces/zephyr-codespace/zephyr/soc/infineon/cat1a/Kconfig"
osource "/workspaces/zephyr-codespace/zephyr/soc/gd/gd32/Kconfig"
osource "/workspaces/zephyr-codespace/zephyr/soc/gaisler/leon3/Kconfig"
osource "/workspaces/zephyr-codespace/zephyr/soc/gaisler/gr716a/Kconfig"
osource "/workspaces/zephyr-codespace/zephyr/soc/espressif/Kconfig"
osource "/workspaces/zephyr-codespace/zephyr/soc/ene/kb1200/Kconfig"
osource "/workspaces/zephyr-codespace/zephyr/soc/efinix/sapphire/Kconfig"
osource "/workspaces/zephyr-codespace/zephyr/soc/cdns/xtensa_sample_controller/Kconfig"
osource "/workspaces/zephyr-codespace/zephyr/soc/cdns/sample_controller32/Kconfig"
osource "/workspaces/zephyr-codespace/zephyr/soc/cdns/dc233c/Kconfig"
osource "/workspaces/zephyr-codespace/zephyr/soc/brcm/bcmvk/Kconfig"
osource "/workspaces/zephyr-codespace/zephyr/soc/brcm/bcm2712/Kconfig"
osource "/workspaces/zephyr-codespace/zephyr/soc/brcm/bcm2711/Kconfig"
osource "/workspaces/zephyr-codespace/zephyr/soc/atmel/sam0/Kconfig"
osource "/workspaces/zephyr-codespace/zephyr/soc/atmel/sam/Kconfig"
osource "/workspaces/zephyr-codespace/zephyr/soc/aspeed/Kconfig"
osource "/workspaces/zephyr-codespace/zephyr/soc/arm/Kconfig"
osource "/workspaces/zephyr-codespace/zephyr/soc/arm/beetle/Kconfig"
osource "/workspaces/zephyr-codespace/zephyr/soc/andestech/Kconfig"
osource "/workspaces/zephyr-codespace/zephyr/soc/ambiq/Kconfig"
osource "/workspaces/zephyr-codespace/zephyr/soc/altr/zephyr_nios2f/Kconfig"
osource "/workspaces/zephyr-codespace/zephyr/soc/altr/qemu_nios2/Kconfig"
osource "/workspaces/zephyr-codespace/zephyr/soc/adi/max32/Kconfig"
```

## build/Kconfig/soc/Kconfig.sysbuild
```kconfig
# Load Sysbuild SoC Kconfig descriptions.
osource "/workspaces/zephyr-codespace/zephyr/soc/xlnx/zynqmp/Kconfig.sysbuild"
osource "/workspaces/zephyr-codespace/zephyr/soc/xlnx/zynq7000/Kconfig.sysbuild"
osource "/workspaces/zephyr-codespace/zephyr/soc/xen/Kconfig.sysbuild"
osource "/workspaces/zephyr-codespace/zephyr/soc/ti/simplelink/Kconfig.sysbuild"
osource "/workspaces/zephyr-codespace/zephyr/soc/ti/lm3s6965/Kconfig.sysbuild"
osource "/workspaces/zephyr-codespace/zephyr/soc/ti/k3/Kconfig.sysbuild"
osource "/workspaces/zephyr-codespace/zephyr/soc/telink/tlsr/Kconfig.sysbuild"
osource "/workspaces/zephyr-codespace/zephyr/soc/starfive/jh71xx/Kconfig.sysbuild"
osource "/workspaces/zephyr-codespace/zephyr/soc/st/stm32/Kconfig.sysbuild"
osource "/workspaces/zephyr-codespace/zephyr/soc/snps/qemu_arc/Kconfig.sysbuild"
osource "/workspaces/zephyr-codespace/zephyr/soc/snps/nsim/arc_v/Kconfig.sysbuild"
osource "/workspaces/zephyr-codespace/zephyr/soc/snps/nsim/arc_classic/Kconfig.sysbuild"
osource "/workspaces/zephyr-codespace/zephyr/soc/snps/hsdk4xd/Kconfig.sysbuild"
osource "/workspaces/zephyr-codespace/zephyr/soc/snps/hsdk/Kconfig.sysbuild"
osource "/workspaces/zephyr-codespace/zephyr/soc/snps/emsk/Kconfig.sysbuild"
osource "/workspaces/zephyr-codespace/zephyr/soc/snps/emsdp/Kconfig.sysbuild"
osource "/workspaces/zephyr-codespace/zephyr/soc/snps/arc_iot/Kconfig.sysbuild"
osource "/workspaces/zephyr-codespace/zephyr/soc/silabs/Kconfig.sysbuild"
osource "/workspaces/zephyr-codespace/zephyr/soc/sifive/sifive_freedom/Kconfig.sysbuild"
osource "/workspaces/zephyr-codespace/zephyr/soc/sensry/Kconfig.sysbuild"
osource "/workspaces/zephyr-codespace/zephyr/soc/rockchip/Kconfig.sysbuild"
osource "/workspaces/zephyr-codespace/zephyr/soc/renode/riscv_virtual/Kconfig.sysbuild"
osource "/workspaces/zephyr-codespace/zephyr/soc/renode/cortex_r8_virtual/Kconfig.sysbuild"
osource "/workspaces/zephyr-codespace/zephyr/soc/renesas/smartbond/Kconfig.sysbuild"
osource "/workspaces/zephyr-codespace/zephyr/soc/renesas/rzt2m/Kconfig.sysbuild"
osource "/workspaces/zephyr-codespace/zephyr/soc/renesas/rcar/Kconfig.sysbuild"
osource "/workspaces/zephyr-codespace/zephyr/soc/renesas/ra/Kconfig.sysbuild"
osource "/workspaces/zephyr-codespace/zephyr/soc/raspberrypi/Kconfig.sysbuild"
osource "/workspaces/zephyr-codespace/zephyr/soc/quicklogic/eos_s3/Kconfig.sysbuild"
osource "/workspaces/zephyr-codespace/zephyr/soc/qemu/virt_riscv/Kconfig.sysbuild"
osource "/workspaces/zephyr-codespace/zephyr/soc/qemu/malta/Kconfig.sysbuild"
osource "/workspaces/zephyr-codespace/zephyr/soc/openisa/rv32m1/Kconfig.sysbuild"
osource "/workspaces/zephyr-codespace/zephyr/soc/nxp/s32/Kconfig.sysbuild"
osource "/workspaces/zephyr-codespace/zephyr/soc/nxp/rw/Kconfig.sysbuild"
osource "/workspaces/zephyr-codespace/zephyr/soc/nxp/mcx/Kconfig.sysbuild"
osource "/workspaces/zephyr-codespace/zephyr/soc/nxp/lpc/Kconfig.sysbuild"
osource "/workspaces/zephyr-codespace/zephyr/soc/nxp/layerscape/Kconfig.sysbuild"
osource "/workspaces/zephyr-codespace/zephyr/soc/nxp/kinetis/Kconfig.sysbuild"
osource "/workspaces/zephyr-codespace/zephyr/soc/nxp/imxrt/Kconfig.sysbuild"
osource "/workspaces/zephyr-codespace/zephyr/soc/nxp/imx/Kconfig.sysbuild"
osource "/workspaces/zephyr-codespace/zephyr/soc/nuvoton/numicro/Kconfig.sysbuild"
osource "/workspaces/zephyr-codespace/zephyr/soc/nuvoton/numaker/Kconfig.sysbuild"
osource "/workspaces/zephyr-codespace/zephyr/soc/nuvoton/npcx/Kconfig.sysbuild"
osource "/workspaces/zephyr-codespace/zephyr/soc/nuvoton/npcm/Kconfig.sysbuild"
osource "/workspaces/zephyr-codespace/zephyr/soc/nordic/Kconfig.sysbuild"
osource "/workspaces/zephyr-codespace/zephyr/soc/neorv32/Kconfig.sysbuild"
osource "/workspaces/zephyr-codespace/zephyr/soc/native/inf_clock/Kconfig.sysbuild"
osource "/workspaces/zephyr-codespace/zephyr/soc/microchip/miv/Kconfig.sysbuild"
osource "/workspaces/zephyr-codespace/zephyr/soc/microchip/mec/Kconfig.sysbuild"
osource "/workspaces/zephyr-codespace/zephyr/soc/mediatek/mtk_adsp/Kconfig.sysbuild"
osource "/workspaces/zephyr-codespace/zephyr/soc/lowrisc/opentitan/Kconfig.sysbuild"
osource "/workspaces/zephyr-codespace/zephyr/soc/litex/litex_vexriscv/Kconfig.sysbuild"
osource "/workspaces/zephyr-codespace/zephyr/soc/ite/ec/Kconfig.sysbuild"
osource "/workspaces/zephyr-codespace/zephyr/soc/intel/raptor_lake/Kconfig.sysbuild"
osource "/workspaces/zephyr-codespace/zephyr/soc/intel/lakemont/Kconfig.sysbuild"
osource "/workspaces/zephyr-codespace/zephyr/soc/intel/intel_socfpga_std/Kconfig.sysbuild"
osource "/workspaces/zephyr-codespace/zephyr/soc/intel/intel_socfpga/Kconfig.sysbuild"
osource "/workspaces/zephyr-codespace/zephyr/soc/intel/intel_niosv/Kconfig.sysbuild"
osource "/workspaces/zephyr-codespace/zephyr/soc/intel/intel_ish/Kconfig.sysbuild"
osource "/workspaces/zephyr-codespace/zephyr/soc/intel/intel_adsp/Kconfig.sysbuild"
osource "/workspaces/zephyr-codespace/zephyr/soc/intel/elkhart_lake/Kconfig.sysbuild"
osource "/workspaces/zephyr-codespace/zephyr/soc/intel/atom/Kconfig.sysbuild"
osource "/workspaces/zephyr-codespace/zephyr/soc/intel/apollo_lake/Kconfig.sysbuild"
osource "/workspaces/zephyr-codespace/zephyr/soc/intel/alder_lake/Kconfig.sysbuild"
osource "/workspaces/zephyr-codespace/zephyr/soc/infineon/cat3/Kconfig.sysbuild"
osource "/workspaces/zephyr-codespace/zephyr/soc/infineon/cat1b/Kconfig.sysbuild"
osource "/workspaces/zephyr-codespace/zephyr/soc/infineon/cat1a/Kconfig.sysbuild"
osource "/workspaces/zephyr-codespace/zephyr/soc/gd/gd32/Kconfig.sysbuild"
osource "/workspaces/zephyr-codespace/zephyr/soc/gaisler/leon3/Kconfig.sysbuild"
osource "/workspaces/zephyr-codespace/zephyr/soc/gaisler/gr716a/Kconfig.sysbuild"
osource "/workspaces/zephyr-codespace/zephyr/soc/espressif/Kconfig.sysbuild"
osource "/workspaces/zephyr-codespace/zephyr/soc/ene/kb1200/Kconfig.sysbuild"
osource "/workspaces/zephyr-codespace/zephyr/soc/efinix/sapphire/Kconfig.sysbuild"
osource "/workspaces/zephyr-codespace/zephyr/soc/cdns/xtensa_sample_controller/Kconfig.sysbuild"
osource "/workspaces/zephyr-codespace/zephyr/soc/cdns/sample_controller32/Kconfig.sysbuild"
osource "/workspaces/zephyr-codespace/zephyr/soc/cdns/dc233c/Kconfig.sysbuild"
osource "/workspaces/zephyr-codespace/zephyr/soc/brcm/bcmvk/Kconfig.sysbuild"
osource "/workspaces/zephyr-codespace/zephyr/soc/brcm/bcm2712/Kconfig.sysbuild"
osource "/workspaces/zephyr-codespace/zephyr/soc/brcm/bcm2711/Kconfig.sysbuild"
osource "/workspaces/zephyr-codespace/zephyr/soc/atmel/sam0/Kconfig.sysbuild"
osource "/workspaces/zephyr-codespace/zephyr/soc/atmel/sam/Kconfig.sysbuild"
osource "/workspaces/zephyr-codespace/zephyr/soc/aspeed/Kconfig.sysbuild"
osource "/workspaces/zephyr-codespace/zephyr/soc/arm/Kconfig.sysbuild"
osource "/workspaces/zephyr-codespace/zephyr/soc/arm/beetle/Kconfig.sysbuild"
osource "/workspaces/zephyr-codespace/zephyr/soc/andestech/Kconfig.sysbuild"
osource "/workspaces/zephyr-codespace/zephyr/soc/ambiq/Kconfig.sysbuild"
osource "/workspaces/zephyr-codespace/zephyr/soc/altr/zephyr_nios2f/Kconfig.sysbuild"
osource "/workspaces/zephyr-codespace/zephyr/soc/altr/qemu_nios2/Kconfig.sysbuild"
osource "/workspaces/zephyr-codespace/zephyr/soc/adi/max32/Kconfig.sysbuild"
```
